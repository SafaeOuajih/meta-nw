## conf/layer.conf
```bitbake
# We have a conf and classes directory, add to BBPATH
BBPATH .= ":${LAYERDIR}"

# We have recipes-* directories, add to BBFILES
BBFILES += "${LAYERDIR}/recipes-*/*/*.bb \
            ${LAYERDIR}/recipes-*/*/*.bbappend"

BBFILE_COLLECTIONS += "meta-nw"
BBFILE_PATTERN_meta-nw = "^${LAYERDIR}/"
BBFILE_PRIORITY_meta-nw = "6"

LAYERDEPENDS_meta-nw = "core"
LAYERSERIES_COMPAT_meta-nw = "mickledore"
```
